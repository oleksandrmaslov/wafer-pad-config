## src/imu/Kconfig
```kconfig
# Copyright (c) 2026 Wafer Pad contributors
# SPDX-License-Identifier: Apache-2.0

menu "IMU (LSM6DSOX accelerometer / gyroscope)"

config WAFER_PAD_IMU
	bool "IMU source (DT alias motion0, Zephyr sensor API)"
	default y
	depends on SENSOR
	help
	  Sample the IMU bound to the devicetree alias motion0 (st,lsm6dso
	  driver for the LSM6DSOX) in a dedicated thread, rotate the samples
	  into the body frame, remove the gyroscope bias and post them to the
	  event router. If disabled, or if the alias/device is missing, the
	  wp_imu_source_* API degrades to stubs (-ENODEV / not present).

if WAFER_PAD_IMU

config WAFER_PAD_IMU_ODR_HZ
	int "Active sampling rate (Hz)"
	range 12 208
	default 104
	help
	  Accelerometer/gyroscope output data rate and polling rate while
	  active. The st,lsm6dso driver rounds up to the next supported ODR
	  (12.5, 26, 52, 104, 208 Hz).

config WAFER_PAD_IMU_LOW_RATE_HZ
	int "Low-rate (IDLE) sampling rate (Hz)"
	range 12 104
	default 26
	help
	  Accelerometer ODR and polling rate in low-rate mode
	  (wp_imu_source_set_low_rate(true)); the gyroscope is off then.

config WAFER_PAD_IMU_GYRO_SETTLE_MS
	int "Gyroscope turn-on settle time (ms)"
	range 0 1000
	default 80
	help
	  Samples are flagged gyro_valid=false for this long after the
	  gyroscope is powered up again.

config WAFER_PAD_IMU_ACCEL_SETTLE_MS
	int "Accelerometer settle time after a data-rate change (ms)"
	range 0 1000
	default 100
	help
	  After every accelerometer ODR change (IDLE entry 104 -> 26 Hz,
	  wake-up 26 -> 104 Hz, re-init) samples are discarded for this long
	  and the next one is flagged restart, so the motion detector starts
	  over instead of reading the transition as movement. 100 ms covers
	  two samples at 26 Hz. Without it the pad woke itself from IDLE
	  about 40 ms after entering it (seen on the nice!nano prototype).

config WAFER_PAD_IMU_READ_ERROR_LIMIT
	int "Consecutive read errors before reporting an IMU error"
	range 1 100
	default 5

config WAFER_PAD_IMU_THREAD_STACK_SIZE
	int "IMU thread stack size"
	default 2048

config WAFER_PAD_IMU_THREAD_PRIORITY
	int "IMU thread priority (preemptible)"
	default 5

config WAFER_PAD_IMU_BIAS_PERSIST
	bool "Persist the gyroscope bias (settings key wp/imu/bias)"
	default y
	depends on SETTINGS
	help
	  Load the last gyroscope bias at boot and save it at most once per
	  WAFER_PAD_IMU_BIAS_SAVE_INTERVAL_S, only when it changed by more
	  than WAFER_PAD_IMU_BIAS_SAVE_MIN_CHANGE_MILLI_DPS.

config WAFER_PAD_IMU_BIAS_SAVE_INTERVAL_S
	int "Minimum interval between bias saves (s)"
	range 1 86400
	default 60
	depends on WAFER_PAD_IMU_BIAS_PERSIST

config WAFER_PAD_IMU_BIAS_SAVE_MIN_CHANGE_MILLI_DPS
	int "Minimum bias change to save (milli-dps)"
	range 0 10000
	default 50
	depends on WAFER_PAD_IMU_BIAS_PERSIST

config WAFER_PAD_IMU_WAKEUP
	bool "IMU wake-up (activity) interrupt on INT1 as System OFF wake source"
	default n
	depends on I2C && GPIO
	help
	  wp_imu_source_prepare_wakeup() programs the LSM6DSOX wake-up
	  interrupt on INT1 with raw register writes and configures the
	  motion0 node's irq-gpios (D4 / P0.22) as a level wake source.
	  Requires irq-gpios on the motion0 node; otherwise -ENOTSUP.

config WAFER_PAD_IMU_WAKEUP_THS_MILLI_G
	int "Wake-up threshold (milli-g)"
	range 16 1000
	default 63
	depends on WAFER_PAD_IMU_WAKEUP
	help
	  Slope threshold of the wake-up interrupt, rounded to the
	  WAKE_UP_THS resolution (full scale / 256, i.e. 15.625 mg at +-4 g).

endif # WAFER_PAD_IMU

# ---- Mounting: IMU axes -> body frame (see include/wafer_pad/types.h) ------

config WAFER_PAD_IMU_MOUNT_X
	int "Body x axis = sign * IMU axis index"
	range -3 3
	default 1
	help
	  body[0] = sign(v) * imu[|v| - 1]: 1 = +X_imu, -1 = -X_imu,
	  2 = +Y_imu, ... The three |values| must be a permutation of 1,2,3
	  (checked at build time). 0 is invalid.

config WAFER_PAD_IMU_MOUNT_Y
	int "Body y axis = sign * IMU axis index"
	range -3 3
	default 2
	help
	  body[1] = sign(v) * imu[|v| - 1]. See WAFER_PAD_IMU_MOUNT_X.

config WAFER_PAD_IMU_MOUNT_Z
	int "Body z axis = sign * IMU axis index"
	range -3 3
	default 3
	help
	  body[2] = sign(v) * imu[|v| - 1]. See WAFER_PAD_IMU_MOUNT_X.

# ---- Gyroscope bias estimator (struct wp_gyro_bias_config) -----------------

config WAFER_PAD_IMU_BIAS_STILL_GYRO_CENTI_DPS
	int "Bias: still if |gyro - bias| below (centi-dps)"
	range 1 10000
	default 100
	help
	  Keep this well below the slowest deliberate air-mouse rotation
	  (a few dps): a larger band lets the bias EMA absorb slow aiming
	  and the cursor stops while the hand keeps turning.

config WAFER_PAD_IMU_BIAS_STILL_ACCEL_DEV_MILLI_G
	int "Bias: still if dynamic accel below (milli-g)"
	range 1 1000
	default 30

config WAFER_PAD_IMU_BIAS_STILL_MIN_MS
	int "Bias: stillness needed before (re)estimating (ms)"
	range 50 60000
	default 800

config WAFER_PAD_IMU_BIAS_ALPHA_MILLI
	int "Bias: EMA factor per still sample (x1000)"
	range 0 1000
	default 20

config WAFER_PAD_IMU_BIAS_MAX_DECI_DPS
	int "Bias: reject estimates above (deci-dps)"
	range 1 1000
	default 100

# ---- Motion features (struct wp_motion_config) ------------------------------

config WAFER_PAD_IMU_MOTION_STILL_GYRO_CENTI_DPS
	int "Motion: still if |gyro| below (centi-dps)"
	range 1 10000
	default 150

config WAFER_PAD_IMU_MOTION_STILL_ACCEL_DEV_MILLI_G
	int "Motion: still if dynamic accel below (milli-g)"
	range 1 1000
	default 15

config WAFER_PAD_IMU_MOTION_STILL_WINDOW_MS
	int "Motion: continuous stillness needed for 'still' (ms)"
	range 0 60000
	default 300

config WAFER_PAD_IMU_MOTION_MOVE_GYRO_DECI_DPS
	int "Motion: moving if |gyro| above (deci-dps)"
	range 1 20000
	default 200

config WAFER_PAD_IMU_MOTION_MOVE_ACCEL_DEV_MILLI_G
	int "Motion: moving if dynamic accel above (milli-g)"
	range 1 4000
	default 60

config WAFER_PAD_IMU_MOTION_TREMOR_TAU_MS
	int "Motion: tremor / jitter RMS EMA time constant (ms)"
	range 1 10000
	default 250

config WAFER_PAD_IMU_MOTION_ACCEL_LP_TAU_MS
	int "Motion: gravity low-pass time constant (ms)"
	range 1 10000
	default 400

config WAFER_PAD_IMU_MOTION_HANDHELD_TREMOR_CENTI_DPS
	int "Motion: gyro tremor RMS suggesting a hand (centi-dps)"
	range 1 10000
	default 35

config WAFER_PAD_IMU_MOTION_HANDHELD_JITTER_MILLI_G
	int "Motion: accel jitter RMS suggesting a hand, gyro off (milli-g)"
	range 1 1000
	default 4

# ---- Plausibility watchdog (src/imu/imu_algo.c, wp_imu_plaus_*) ----------

config WAFER_PAD_IMU_DEAD_MS
	int "Implausible-reading watchdog time (ms, 0 = off)"
	range 0 10000
	default 500
	help
	  A silent sensor reset (rail glitch) leaves the LSM6DSOX in
	  power-down: reads succeed but return zeros. If |accel| stays below
	  WAFER_PAD_IMU_DEAD_ACCEL_MILLI_G, or the enabled and settled gyro
	  reads exactly 0,0,0, for longer than this, a warning is logged,
	  WP_IMU_STATUS_ERROR is posted and the sensor is re-initialized.
	  500 ms: longer than a fall from table height (0.4 s); only a free
	  fall from more than 1.2 m lasts longer, and a re-init then is
	  harmless.

config WAFER_PAD_IMU_DEAD_ACCEL_MILLI_G
	int "Implausibly low |accel| for the watchdog (0.001 g)"
	range 1 1000
	default 200
	help
	  200 = 0.2 g. At rest or in the hand |accel| is about 1 g; below
	  0.2 g only in free fall.

endmenu
```

## src/orientation/Kconfig
```kconfig
# Copyright (c) 2026 Wafer Pad contributors
# SPDX-License-Identifier: Apache-2.0
#
# Orientation detection (algorithms A-D) and the manual calibration gesture.
# Defaults MUST equal the C defaults in src/orientation/orientation_*.c
# (wp_orient_*_config_default, wp_calib_config_default).

menu "Orientation detection"

config WAFER_PAD_ORIENT_AUTO
	bool "Automatic orientation from gravity (algorithm A)"
	default y
	help
	  Derive the orientation from the gravity direction while the pad is
	  tilted (raised edge = away from the user). When the pad lies flat the
	  last orientation is kept. Can also be toggled at runtime.

config WAFER_PAD_ORIENT_DEFAULT_DEG
	int "Boot orientation in degrees (0, 90, 180 or 270)"
	range 0 270
	default 0
	help
	  Clockwise rotation of the pad at boot, see include/wafer_pad/types.h.
	  Only 0, 90, 180 and 270 are accepted (checked at build time).

config WAFER_PAD_ORIENT_MIN_TILT_DEG
	int "Minimum tilt for a gravity fix (deg)"
	range 1 89
	default 20
	help
	  Below this tilt the pad counts as flat: gravity carries no heading
	  information and the last orientation is kept.

config WAFER_PAD_ORIENT_MAX_TILT_DEG
	int "Maximum tilt for a gravity fix (deg)"
	range 2 90
	default 75
	help
	  Above this tilt (near vertical, upside down) samples are rejected.

config WAFER_PAD_ORIENT_MAX_MAG_DEV_MILLI_G
	int "Maximum acceleration magnitude deviation (milli-g)"
	range 10 1000
	default 120
	help
	  Samples with | |a|/g - 1 | above this are rejected (pad being lifted,
	  shaken or carried).

config WAFER_PAD_ORIENT_HYSTERESIS_DEG
	int "Heading hysteresis (deg)"
	range 0 44
	default 15
	help
	  A new orientation becomes a candidate only when the heading is within
	  (45 - hysteresis) degrees of its quadrant centre.

config WAFER_PAD_ORIENT_MAX_GYRO_DPS
	int "Reject gravity samples above this rotation rate (deg/s)"
	range 1 2000
	default 20

config WAFER_PAD_ORIENT_CONFIRM_MS
	int "Candidate confirmation time (ms)"
	range 0 10000
	default 300

config WAFER_PAD_ORIENT_CONFIRM_NO_GYRO_MS
	int "Candidate confirmation time while the gyro is off (ms)"
	range 0 10000
	default 800
	help
	  Without gyro data the rotation rate cannot be checked, so a slow
	  pick-up or put-down sweep must be rejected by time and tilt
	  stability alone.

config WAFER_PAD_ORIENT_MAX_TILT_CHANGE_DEG
	int "Maximum tilt change during the confirmation (deg)"
	range 0 45
	default 6
	help
	  The candidate timer restarts when the tilt moves more than this
	  from its value at the start: a steadily changing tilt is a
	  pick-up / put-down transient, not a posture. 0 disables the check.

config WAFER_PAD_ORIENT_MIN_CONFIDENCE_CENTI
	int "Minimum confidence to confirm (x0.01)"
	range 0 100
	default 60

config WAFER_PAD_ORIENT_LPF_TAU_MS
	int "Gravity low-pass time constant (ms)"
	range 0 2000
	default 50

config WAFER_PAD_ORIENT_MANUAL_LOCK_MODE
	int "Manual lock mode (0 none, 1 timed, 2 until recalibration)"
	range 0 2
	default 1
	help
	  What a manual calibration (or forced orientation) does to automatic
	  detection: 0 = auto may override immediately, 1 = auto disabled for
	  WAFER_PAD_ORIENT_MANUAL_LOCK_MS, 2 = auto disabled until the next
	  calibration or until auto is re-enabled at runtime.

config WAFER_PAD_ORIENT_MANUAL_LOCK_MS
	int "Manual lock duration (ms)"
	range 0 3600000
	default 30000

config WAFER_PAD_ORIENT_TOUCH_SETTLE_MS
	int "Settle time after the last finger lifts (ms)"
	range 0 5000
	default 150
	help
	  An automatic orientation change found while touching is applied only
	  after all fingers have been up for this long.

config WAFER_PAD_ORIENT_GYRO_ASSIST
	bool "Gyro-assisted rotation tracking (algorithm D, experimental)"
	help
	  After a confident fix, track 90 degree rotations about the pad normal
	  with the gyroscope while the pad is flat or moderately tilted.

if WAFER_PAD_ORIENT_GYRO_ASSIST

config WAFER_PAD_ORIENT_GYRO_STEP_DEG
	int "Accumulated yaw for one 90 degree step (deg)"
	range 30 89
	default 70

config WAFER_PAD_ORIENT_GYRO_MIN_RATE_DPS
	int "Ignore yaw rates below (deg/s)"
	range 0 500
	default 8

config WAFER_PAD_ORIENT_GYRO_MAX_WINDOW_MS
	int "Yaw accumulation window (ms)"
	range 100 10000
	default 1500

config WAFER_PAD_ORIENT_GYRO_MAX_TILT_DEG
	int "Only integrate below this tilt (deg)"
	range 1 89
	default 50

endif # WAFER_PAD_ORIENT_GYRO_ASSIST

comment "Manual calibration gesture (hold, then swipe away from you)"

config WAFER_PAD_CALIB_FINGERS
	int "Fingers for the calibration gesture"
	range 1 5
	default 3
	help
	  3 by default: a two-finger hold followed by a flick is a normal
	  scroll and must never change the orientation.

config WAFER_PAD_CALIB_HOLD_MS
	int "Hold time before the gesture arms (ms)"
	range 100 5000
	default 1500

config WAFER_PAD_CALIB_HOLD_MAX_MOVE_CENTI_MM
	int "Maximum finger movement while holding (x0.01 mm)"
	range 10 1000
	default 150

config WAFER_PAD_CALIB_ARM_TIMEOUT_MS
	int "Time allowed between arming and the swipe (ms)"
	range 100 10000
	default 2500

config WAFER_PAD_CALIB_SWIPE_START_CENTI_MM
	int "Centroid movement that starts the swipe timer (x0.01 mm)"
	range 10 2000
	default 200

config WAFER_PAD_CALIB_SWIPE_MIN_MM
	int "Minimum swipe distance (mm)"
	range 3 60
	default 25

config WAFER_PAD_CALIB_SWIPE_MAX_MS
	int "Maximum swipe duration (ms)"
	range 50 2000
	default 450

config WAFER_PAD_CALIB_SWIPE_MAX_ANGLE_DEV_DEG
	int "Maximum swipe deviation from a pad axis (deg)"
	range 5 44
	default 30

config WAFER_PAD_CALIB_LIFT_MAX_MS
	int "Fingers must lift within this time after the swipe (ms)"
	range 50 2000
	default 250

endmenu
```

## src/power/Kconfig
```kconfig
# Copyright (c) 2026 Wafer Pad contributors
# SPDX-License-Identifier: Apache-2.0

menu "Power management, battery and status LED"

config WAFER_PAD_SLEEP
	bool "Allow System OFF deep sleep"
	default y
	depends on HAS_POWEROFF
	select POWEROFF
	imply HWINFO
	help
	  Lets wp_power_enter_sleep() arm the wake sources (touch RDY, IMU
	  INT1 if wired) and enter nRF52 System OFF (wake = reset).
	  This option only makes sleep POSSIBLE: WHEN to sleep is decided by
	  the state machine (sleep_enabled, sleep/disconnected timeouts in the
	  "state" menu, off by default for the exhibition build). The power
	  module only executes. The P0.13 sensor rail (3V3 header pin) is
	  never switched off automatically.
	  If disabled, a sleep request is refused and the router restarts the
	  state machine instead.

config WAFER_PAD_BATTERY
	bool "Battery measurement and BLE Battery Service updates"
	default y
	depends on ADC
	help
	  Measures VDDH/5 with the SAADC channel from the zephyr,user
	  io-channels property and reports a LiPo state of charge through
	  wp_ble_set_battery_level(). On USB power WITHOUT a battery, VDDH is
	  the charger output (about 4.2 V or more), so the value reads ~100 %
	  and is meaningless.

config WAFER_PAD_BATTERY_INTERVAL_S
	int "Battery measurement interval [s]"
	default 60
	range 5 3600
	depends on WAFER_PAD_BATTERY

config WAFER_PAD_LED
	bool "Status LED (devicetree alias led0)"
	default y
	depends on GPIO
	help
	  Non-blocking blink patterns (advertising, connected, calibration,
	  air mouse, error, mode / orientation feedback) on led0.

endmenu
```
