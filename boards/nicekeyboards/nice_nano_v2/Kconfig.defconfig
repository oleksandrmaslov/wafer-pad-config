## boards/nicekeyboards/nice_nano_v2/board.yml
```yaml
board:
  name: nice_nano_v2
  full_name: nice!nano v2
  vendor: nicekeyboards
  socs:
    - name: nrf52840
```

## drivers/azoteq/Kconfig
```kconfig
# Copyright (c) 2026 Wafer Pad contributors
# SPDX-License-Identifier: Apache-2.0

config AZOTEQ_IQS5XX
	bool "Azoteq IQS5xx-B000 trackpad controller (TPS65)"
	default y
	depends on DT_HAS_AZOTEQ_IQS5XX_ENABLED
	select I2C
	select GPIO
	help
	  Out-of-tree driver for the Azoteq IQS550/IQS572/IQS525 running the
	  B000 trackpad firmware (e.g. the TPS65 module). Delivers complete
	  multi-touch frames through a callback (drivers/azoteq_iqs5xx.h).

if AZOTEQ_IQS5XX

config AZOTEQ_IQS5XX_INIT_PRIORITY
	int "Azoteq IQS5xx init priority"
	default 80
	help
	  POST_KERNEL init priority. Must be higher (later) than the I2C
	  controller (I2C_INIT_PRIORITY, 50) and the fixed regulator that
	  powers the sensor rail through P0.13 (REGULATOR_FIXED_INIT_PRIORITY,
	  75), and LOWER (earlier) than the other devices on the shared bus
	  (SENSOR_INIT_PRIORITY, 90): device init holds the controller in
	  reset and clocks the bus free once, so a slave left holding SDA by a
	  warm reset cannot make the IMU probe fail. Device init only
	  configures the GPIOs and queues the controller bring-up on the
	  driver work queue, so it never blocks boot for long.

config AZOTEQ_IQS5XX_WORKQ_STACK_SIZE
	int "Azoteq IQS5xx work queue stack size"
	default 1536
	help
	  Stack of the driver's dedicated work queue. Frame reads, bring-up,
	  recovery and the user callback run on this thread.

config AZOTEQ_IQS5XX_WORKQ_PRIORITY
	int "Azoteq IQS5xx work queue thread priority"
	default 2
	help
	  Preemptible priority of the driver work queue thread. Keep it higher
	  (numerically lower) than the consumers of the touch frames.
	  Priority alone cannot guarantee that RDY is re-armed before
	  sys_poweroff() (the handler blocks on I2C mid-service): the caller
	  must call iqs5xx_arm_wake_pin() with interrupts locked right before
	  sys_poweroff().

config AZOTEQ_IQS5XX_RDY_TIMEOUT_MS
	int "Streaming mode RDY timeout (ms)"
	default 2000
	range 100 60000
	help
	  In streaming mode the controller opens a window every report cycle.
	  If no RDY arrives for this long while initialized, the driver treats
	  it as a communication error and runs the recovery sequence.

config AZOTEQ_IQS5XX_STALE_MS
	int "Event mode stale-contact timeout (ms)"
	default 300
	range 20 60000
	help
	  In event mode, if the last frame had fingers down and no RDY arrived
	  for this long, the driver performs one forced read (outside a RDY
	  window) so that a lost finger-up event cannot leave a stuck contact.
	  Forced reads clock-stretch the shared I2C bus for up to one report
	  period; they are counted in iqs5xx_stats.forced_reads.

module = AZOTEQ_IQS5XX
module-str = azoteq_iqs5xx
source "subsys/logging/Kconfig.template.log_config"

endif # AZOTEQ_IQS5XX
```

## src/air_mouse/Kconfig
```kconfig
# Copyright (c) 2026 Wafer Pad contributors
# SPDX-License-Identifier: Apache-2.0
#
# Air mouse (gyroscope angular rate -> cursor). Defaults equal
# wp_air_mouse_config_default() in src/air_mouse/air_mouse.c.

menu "Air mouse"

config WAFER_PAD_AIR_COUNTS_PER_DEG_CENTI
	int "Air mouse sensitivity [counts per degree x100]"
	range 1 100000
	default 1200
	help
	  Cursor counts per degree of hand rotation, times 100.
	  1200 = 12.00 counts/deg.

config WAFER_PAD_AIR_DEADZONE_DECI_DPS
	int "Soft deadzone [deg/s x10]"
	range 0 500
	default 15
	help
	  Angular rates at or below this are ignored; above it the deadzone is
	  subtracted (soft deadzone). 15 = 1.5 deg/s.

config WAFER_PAD_AIR_LPF_CUTOFF_HZ
	int "Rate low-pass cutoff [Hz]"
	range 0 200
	default 15
	help
	  Cutoff of the 1-pole low-pass on the projected angular rates.
	  0 disables the filter.

config WAFER_PAD_AIR_MAX_RATE_DPS
	int "Maximum angular rate after the deadzone [deg/s]"
	range 10 2000
	default 400

config WAFER_PAD_AIR_RAMP_IN_MS
	int "Gain ramp-in after the clutch engages [ms]"
	range 0 2000
	default 120
	help
	  The gain rises linearly from 0 to 1 over this time after the air
	  mouse is started. 0 = full gain immediately.

config WAFER_PAD_AIR_GRAVITY_COMP
	bool "Gravity-compensated axes"
	default y
	help
	  Yaw is measured about the world vertical (low-passed specific force)
	  and pitch about the horizontal "right" axis, so a tilted pad still
	  maps turning left/right to cursor X. When disabled the pad normal and
	  the pad-plane right axis are used.

config WAFER_PAD_AIR_ACCEL_LP_TAU_MS
	int "Gravity estimate time constant [ms]"
	range 10 5000
	default 150

config WAFER_PAD_AIR_INVERT_X
	bool "Invert air mouse X"
	default n

config WAFER_PAD_AIR_INVERT_Y
	bool "Invert air mouse Y"
	default n

endmenu
```

## src/gestures/Kconfig
```kconfig
# Copyright (c) 2026 Wafer Pad contributors
# SPDX-License-Identifier: Apache-2.0
#
# Trackpad gesture engine and pointer acceleration.
# Defaults are identical to wp_gesture_config_default() and
# wp_pointer_accel_config_default() (src/gestures/*.c).
# Fractional values: _MILLI = x1000, _CENTI = x100.

menu "Gestures and pointer"

config WAFER_PAD_GEST_TAP
	bool "Tap to click"
	default y
	help
	  One-finger tap = left click, two-finger tap = right click.

config WAFER_PAD_GEST_TAP_MAX_MS
	int "Maximum tap duration (ms)"
	default 180
	range 50 1000

config WAFER_PAD_GEST_TAP_MAX_MOVE_CENTI_MM
	int "Maximum finger travel of a tap (0.01 mm)"
	default 150
	range 0 1000
	help
	  Also the travel after which a one-finger touch becomes pointer
	  motion (or a tap-drag). 150 = 1.5 mm.

config WAFER_PAD_GEST_TAP_DRAG
	bool "Tap-drag"
	default y
	help
	  Tap, then touch again within the double-tap window and move:
	  the left button is held while the finger moves.

config WAFER_PAD_GEST_DOUBLE_TAP_WINDOW_MS
	int "Tap-drag window after a tap (ms)"
	default 250
	range 50 2000

config WAFER_PAD_GEST_LONG_PRESS_DRAG
	bool "Long-press drag"
	default y
	help
	  A finger held still for the long-press time presses the left
	  button; moving it drags, lifting it releases.

config WAFER_PAD_GEST_LONG_PRESS_MS
	int "Long-press time (ms)"
	default 450
	range 100 5000

config WAFER_PAD_GEST_LONG_PRESS_MAX_MOVE_CENTI_MM
	int "Maximum travel of a still finger (0.01 mm)"
	default 100
	range 0 1000
	help
	  Radius used by long press and by the "single finger still"
	  output (air-mouse clutch). 100 = 1.0 mm.

config WAFER_PAD_GEST_MULTI_DOWN_SKEW_MS
	int "Simultaneous finger landing window (ms)"
	default 120
	range 0 1000
	help
	  Fingers landing within this time of the first one form a
	  multi-finger gesture (tap / scroll). Later fingers are ignored
	  by a one-finger session.

config WAFER_PAD_GEST_TWO_FINGER_TAP_MAX_MS
	int "Maximum two/three-finger tap duration (ms)"
	default 220
	range 50 2000

config WAFER_PAD_GEST_TWO_FINGER_TAP_MAX_MOVE_CENTI_MM
	int "Maximum finger travel of a two/three-finger tap (0.01 mm)"
	default 200
	range 0 2000

config WAFER_PAD_GEST_THREE_FINGER_TAP
	bool "Three-finger tap event"
	default y

config WAFER_PAD_GEST_SCROLL_DETENTS_PER_MM_MILLI
	int "Scroll wheel detents per mm of two-finger motion (x0.001)"
	default 250
	range 1 10000
	help
	  250 = 0.25 detent per mm (one detent every 4 mm).

config WAFER_PAD_GEST_SCROLL_START_CENTI_MM
	int "Two-finger travel before scrolling starts (0.01 mm)"
	default 100
	range 0 2000

config WAFER_PAD_GEST_SCROLL_AXIS_LOCK
	bool "Lock scrolling to the dominant axis"
	default y

config WAFER_PAD_GEST_SCROLL_AXIS_LOCK_RATIO_CENTI
	int "Axis lock dominance ratio (x0.01)"
	default 200
	range 100 1000

config WAFER_PAD_GEST_SCROLL_NATURAL
	bool "Natural scrolling (content follows the fingers)"
	default y

config WAFER_PAD_GEST_SCROLL_INVERT_PAN
	bool "Invert horizontal pan"
	default n

config WAFER_PAD_GEST_JITTER_DEADBAND_CENTI_MM
	int "Pointer jitter deadband after touch-down (0.01 mm)"
	default 30
	range 0 500

config WAFER_PAD_GEST_SMOOTHING_ALPHA_CENTI
	int "Pointer smoothing alpha at low speed (x0.01, 100 = off)"
	default 60
	range 5 100

config WAFER_PAD_GEST_SMOOTHING_FULL_SPEED_MM_S
	int "Speed above which smoothing is off (mm/s)"
	default 60
	range 0 1000

config WAFER_PAD_GEST_JUMP_MAX_STEP_MM
	int "Implausible per-frame step of one contact (mm, 0 = off)"
	default 15
	range 0 200
	help
	  A contact (same id) that moves farther than this between two
	  frames is treated as a slot reuse / ghost coordinate: the delta
	  is dropped (no pointer jump, no scroll burst) and tracking
	  continues from the new position. 15 mm = 1.5 m/s at the 10 ms
	  report period, above a hard flick; ghost jumps are 20-40 mm.

config WAFER_PAD_GEST_JUMP_MAX_SPEED_MM_S
	int "Implausible finger speed between two frames (mm/s, 0 = off)"
	default 2000
	range 0 20000
	help
	  Same as WAFER_PAD_GEST_JUMP_MAX_STEP_MM, measured as speed from
	  the frame timestamps (catches jumps at faster report rates). A
	  hard flick peaks at about 1-1.5 m/s.

config WAFER_PAD_POINTER_COUNTS_PER_MM_CENTI
	int "Pointer base resolution (HID counts per mm, x0.01)"
	default 1600
	range 100 20000
	help
	  1600 = 16 counts/mm (about 400 CPI).

config WAFER_PAD_POINTER_SENSITIVITY_CENTI
	int "Pointer sensitivity multiplier (x0.01)"
	default 100
	range 10 1000

config WAFER_PAD_POINTER_ACCEL_LOW_SPEED
	int "Acceleration starts above this speed (mm/s)"
	default 20
	range 0 2000

config WAFER_PAD_POINTER_ACCEL_HIGH_SPEED
	int "Full acceleration at and above this speed (mm/s)"
	default 200
	range 1 5000

config WAFER_PAD_POINTER_ACCEL_MAX_MULT_CENTI
	int "Maximum acceleration multiplier (x0.01, 100 = off)"
	default 300
	range 100 1000

endmenu
```

## src/hid/Kconfig
```kconfig
# Copyright (c) 2026 Wafer Pad contributors
# SPDX-License-Identifier: Apache-2.0

menu "HID transport (BLE HID over GATT)"

config WAFER_PAD_BLE_MAX_INFLIGHT
	int "Maximum HID input notifications in flight"
	default 2
	range 1 8
	help
	  Number of HID input report notifications that may be queued in the
	  Bluetooth host/controller at once. When the limit is reached the BLE
	  transport reports "not ready" until a notification completes, so the
	  report composer coalesces motion instead of building a backlog.
	  CONFIG_BT_ATT_TX_COUNT must be at least this + 3 (one ATT response,
	  Service Changed, BAS) so the router thread never blocks waiting for
	  an ATT buffer.

config WAFER_PAD_BLE_PAIRING_WINDOW_S
	int "Pairing window after boot (s)"
	default 120
	range 0 3600
	help
	  New pairings (Just Works) are accepted only while no bond exists,
	  for this long after boot, or after 'wp pair' on the shell. Outside
	  the window only already bonded hosts can connect, so visitors cannot
	  pair their phones and evict the demo host's bond. The window closes
	  after the first successful bonding.

config WAFER_PAD_BLE_ADV_INTERVAL_MIN_US
	int "Advertising interval minimum (us)"
	default 30000
	range 20000 10240000
	help
	  Connectable advertising interval minimum in microseconds; must be a
	  multiple of 625 us. Default 30 ms = BT_GAP_ADV_FAST_INT_MIN_1.

config WAFER_PAD_BLE_ADV_INTERVAL_MAX_US
	int "Advertising interval maximum (us)"
	default 60000
	range 20000 10240000
	help
	  Connectable advertising interval maximum in microseconds; must be a
	  multiple of 625 us and >= the minimum. Default 60 ms =
	  BT_GAP_ADV_FAST_INT_MAX_1.

# Connection parameters requested by wp_ble_set_low_latency(). The central
# decides; Apple Accessory Design Guidelines 57.6 rejects requests that break:
#   interval min >= 15 ms and a multiple of 15 ms (HID: down to 11.25 ms on
#   some devices), interval max >= min + 15 ms or min == max == 15 ms,
#   peripheral latency <= 30, interval max * (latency + 1) <= 6 s,
#   6 s <= supervision timeout <= 18 s,
#   timeout > interval max * (latency + 1) * 3.
# The defaults satisfy all of these (and the Bluetooth Core limits).

config WAFER_PAD_BLE_LL_INTERVAL_MIN_US
	int "Low-latency connection interval minimum (us)"
	default 15000
	range 7500 4000000
	help
	  Requested while the pad is in active use. Multiple of 1250 us.
	  15 ms (min == max) is the shortest Apple-compliant request; hosts
	  without Apple's rules accept 7500 here.

config WAFER_PAD_BLE_LL_INTERVAL_MAX_US
	int "Low-latency connection interval maximum (us)"
	default 15000
	range 7500 4000000
	help
	  Multiple of 1250 us, >= the minimum.

config WAFER_PAD_BLE_LL_LATENCY
	int "Low-latency peripheral latency (connection events)"
	default 0
	range 0 30

config WAFER_PAD_BLE_PS_INTERVAL_MIN_US
	int "Power-saving connection interval minimum (us)"
	default 15000
	range 7500 4000000
	help
	  Requested while the pad is idle. Multiple of 1250 us.

	  Keep the power-saving interval at the low-latency interval and
	  save power with WAFER_PAD_BLE_PS_LATENCY instead. Linux rejects
	  (0x1E, invalid LL parameters) every request whose maximum interval
	  is above the last accepted one (net/bluetooth/hci_event.c,
	  hci_le_remote_conn_param_req_evt), so after the 15 ms low-latency
	  request a longer interval is never granted. Seen on the prototype
	  with BlueZ 5.72 / Linux 7.0.

config WAFER_PAD_BLE_PS_INTERVAL_MAX_US
	int "Power-saving connection interval maximum (us)"
	default 15000
	range 7500 4000000
	help
	  Multiple of 1250 us, >= the minimum. See
	  WAFER_PAD_BLE_PS_INTERVAL_MIN_US.

config WAFER_PAD_BLE_PS_LATENCY
	int "Power-saving peripheral latency (connection events)"
	default 20
	range 0 30
	help
	  The peripheral may skip this many connection events when it has
	  nothing to send. Input reports are still sent at the next event,
	  so wake-up costs no latency. 20 at 15 ms: the radio listens about
	  every 315 ms while idle (Apple limit: interval max * (latency + 1)
	  <= 2 s).

config WAFER_PAD_BLE_SUPERVISION_TIMEOUT_MS
	int "Connection supervision timeout (ms)"
	default 6000
	range 100 32000
	help
	  Used by both parameter sets. Multiple of 10 ms. 6 s is the lowest
	  value Apple's general guideline (57.6) accepts.

endmenu
```
